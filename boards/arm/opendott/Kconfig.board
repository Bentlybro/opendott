## boards/arm/opendott/Kconfig.board
```kconfig
# OpenDOTT board configuration

config BOARD_OPENDOTT
	bool "OpenDOTT Wearable Display"
	depends on SOC_NRF52840_QIAA
	select BOARD_HAS_NRF5_BOOTLOADER
```

## boards/arm/opendott/Kconfig.defconfig
```kconfig
# OpenDOTT nRF52840 board defconfig
# SPDX-License-Identifier: MIT

if BOARD_OPENDOTT

config BT_CTLR
	default BT

endif # BOARD_OPENDOTT
```

## boards/arm/opendott/Kconfig.opendott
```kconfig
# OpenDOTT nRF52840 board configuration
# SPDX-License-Identifier: MIT

config BOARD_OPENDOTT
	select SOC_NRF52840_QIAA
```

## boards/arm/opendott/opendott_defconfig
```kconfig
# OpenDOTT Board Configuration

CONFIG_SOC_SERIES_NRF52X=y
CONFIG_SOC_NRF52840_QIAA=y
CONFIG_BOARD_OPENDOTT=y

# Enable MPU
CONFIG_ARM_MPU=y

# Enable hardware stack protection
CONFIG_HW_STACK_PROTECTION=y

# Clock configuration
CONFIG_CLOCK_CONTROL_NRF=y
CONFIG_CLOCK_CONTROL_NRF_K32SRC_RC=y

# Enable GPIO
CONFIG_GPIO=y

# Console
CONFIG_CONSOLE=y
CONFIG_UART_CONSOLE=y

# Pinctrl
CONFIG_PINCTRL=y
```

## boards/arm/opendott/opendott_nrf52840_defconfig
```kconfig
# OpenDOTT Board Configuration
# Note: SOC/board selection is automatic via board.yml in Zephyr 3.7.0 HWMv2

# Enable MPU
CONFIG_ARM_MPU=y

# Enable hardware stack protection
CONFIG_HW_STACK_PROTECTION=y

# Clock configuration
CONFIG_CLOCK_CONTROL_NRF=y
CONFIG_CLOCK_CONTROL_NRF_K32SRC_RC=y

# Enable GPIO
CONFIG_GPIO=y

# Console
CONFIG_CONSOLE=y
CONFIG_UART_CONSOLE=y

# Pinctrl
CONFIG_PINCTRL=y
```

## firmware/boards/arm/opendott/Kconfig
```kconfig
# OpenDOTT board configuration
# SPDX-License-Identifier: MIT

if BOARD_OPENDOTT

config BOARD_ENABLE_DCDC
	bool "DCDC mode"
	select SOC_DCDC_NRF52X
	default y

endif # BOARD_OPENDOTT
```
